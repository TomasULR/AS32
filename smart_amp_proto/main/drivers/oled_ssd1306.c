#include "oled_ssd1306.h"
#include "esp_log.h"
#include "esp_check.h"
#include "driver/i2c_master.h"
#include "freertos/FreeRTOS.h"
#include "freertos/semphr.h"
#include <string.h>
#include <stdio.h>

#define I2C_PORT        I2C_NUM_0
#define I2C_SDA_GPIO    8
#define I2C_SCL_GPIO    9
#define I2C_FREQ_HZ     400000
#define OLED_ADDR       0x3C

#define OLED_CMD  0x00
#define OLED_DATA 0x40

static const char *TAG = "oled";

static i2c_master_bus_handle_t s_bus   = NULL;
static i2c_master_dev_handle_t s_dev   = NULL;
static SemaphoreHandle_t       s_lock  = NULL;
static uint8_t                 s_fb[OLED_W * OLED_H / 8];

/* Public-domain 5x8 ASCII font (0x20..0x7F), column-major, LSB = top pixel.
 * Adapted from the commonly-redistributed Adafruit GFX "font5x7" layout. */
static const uint8_t FONT5x8[96][5] = {
    {0x00,0x00,0x00,0x00,0x00}, {0x00,0x00,0x5F,0x00,0x00}, {0x00,0x07,0x00,0x07,0x00},
    {0x14,0x7F,0x14,0x7F,0x14}, {0x24,0x2A,0x7F,0x2A,0x12}, {0x23,0x13,0x08,0x64,0x62},
    {0x36,0x49,0x55,0x22,0x50}, {0x00,0x05,0x03,0x00,0x00}, {0x00,0x1C,0x22,0x41,0x00},
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    {0x00,0x41,0x36,0x08,0x00}, {0x02,0x01,0x02,0x04,0x02}, {0x00,0x00,0x00,0x00,0x00},
};

static esp_err_t send_cmd(uint8_t cmd)
{
    uint8_t b[2] = { OLED_CMD, cmd };
    return i2c_master_transmit(s_dev, b, 2, 50);
}

static esp_err_t send_cmd_list(const uint8_t *cmds, size_t n)
{
    for (size_t i = 0; i < n; i++) {
        esp_err_t e = send_cmd(cmds[i]);
        if (e != ESP_OK) return e;
    }
    return ESP_OK;
}

esp_err_t oled_init(void)
{
    s_lock = xSemaphoreCreateMutex();
    ESP_RETURN_ON_FALSE(s_lock, ESP_ERR_NO_MEM, TAG, "lock");

    i2c_master_bus_config_t bus_cfg = {
        .clk_source = I2C_CLK_SRC_DEFAULT,
        .i2c_port = I2C_PORT,
        .scl_io_num = I2C_SCL_GPIO,
        .sda_io_num = I2C_SDA_GPIO,
        .glitch_ignore_cnt = 7,
        .flags.enable_internal_pullup = true,
    };
    ESP_RETURN_ON_ERROR(i2c_new_master_bus(&bus_cfg, &s_bus), TAG, "bus");

    i2c_device_config_t dev_cfg = {
        .dev_addr_length = I2C_ADDR_BIT_LEN_7,
        .device_address = OLED_ADDR,
        .scl_speed_hz = I2C_FREQ_HZ,
    };
    ESP_RETURN_ON_ERROR(i2c_master_bus_add_device(s_bus, &dev_cfg, &s_dev), TAG, "dev");

    /* Standard SSD1306 init sequence for 128x64. */
    static const uint8_t init_seq[] = {
        0xAE,              /* display off */
        0xD5, 0x80,        /* clock divide */
        0xA8, 0x3F,        /* multiplex 63 */
        0xD3, 0x00,        /* offset 0 */
        0x40,              /* start line 0 */
        0x8D, 0x14,        /* charge pump on */
        0x20, 0x00,        /* horizontal addressing */
        0xA1,              /* segment remap */
        0xC8,              /* COM scan dec */
        0xDA, 0x12,        /* COM pins */
        0x81, 0x7F,        /* contrast */
        0xD9, 0xF1,        /* pre-charge */
        0xDB, 0x40,        /* Vcomh */
        0xA4,              /* resume RAM content */
        0xA6,              /* non-inverted */
        0x2E,              /* scroll off */
        0xAF,              /* display on */
    };
    ESP_RETURN_ON_ERROR(send_cmd_list(init_seq, sizeof(init_seq)), TAG, "init_seq");

    oled_clear();
    oled_flush();
    ESP_LOGI(TAG, "SSD1306 up on 0x%02X (SDA=%d SCL=%d)", OLED_ADDR, I2C_SDA_GPIO, I2C_SCL_GPIO);
    return ESP_OK;
}

void oled_clear(void) { memset(s_fb, 0, sizeof(s_fb)); }

void oled_flush(void)
{
    if (!s_dev) return;
    xSemaphoreTake(s_lock, portMAX_DELAY);
    uint8_t win[] = { 0x21, 0, 127, 0x22, 0, 7 };
    send_cmd_list(win, sizeof(win));

    /* Stream framebuffer in 129-byte chunks: 1 control byte + 128 data bytes. */
    uint8_t chunk[129];
    chunk[0] = OLED_DATA;
    for (int page = 0; page < 8; page++) {
        memcpy(&chunk[1], &s_fb[page * OLED_W], OLED_W);
        i2c_master_transmit(s_dev, chunk, sizeof(chunk), 50);
    }
    xSemaphoreGive(s_lock);
}

static void put_char(int x, int page, char c)
{
    if (c < 0x20 || c > 0x7F) c = '?';
    const uint8_t *g = FONT5x8[c - 0x20];
    for (int i = 0; i < 5; i++) {
        int col = x + i;
        if (col < 0 || col >= OLED_W) continue;
        s_fb[page * OLED_W + col] = g[i];
    }
    /* 1-column gap is already inherent: we only draw 5 columns per glyph. */
}

void oled_draw_text(int x, int page, const char *s)
{
    if (!s || page < 0 || page > 7) return;
    int cx = x;
    while (*s) {
        put_char(cx, page, *s++);
        cx += 6;
    }
}

void oled_draw_volume_bar(int percent)
{
    if (percent < 0) percent = 0;
    if (percent > 100) percent = 100;
    /* Bottom page (7): frame + fill. */
    int fill = (percent * (OLED_W - 4)) / 100;
    for (int x = 0; x < OLED_W; x++) {
        uint8_t v = 0;
        if (x == 0 || x == OLED_W - 1) v = 0xFF;
        else if (x < 2 + fill)         v = 0x7E;
        else                           v = 0x81;
        s_fb[7 * OLED_W + x] = v;
    }
}

void oled_draw_source(const char *tag)
{
    if (!tag) tag = "---";
    char buf[4] = {0};
    strncpy(buf, tag, 3);
    oled_draw_text(OLED_W - 6 * 3 - 1, 0, buf);
}

void oled_render_status(const char *title, const char *source, int vol_percent)
{
    oled_clear();
    oled_draw_text(0, 0, title ? title : "SokolAudio");
    oled_draw_source(source);
    char vbuf[16];
    snprintf(vbuf, sizeof vbuf, "VOL %3d%%", vol_percent);
    oled_draw_text(0, 3, vbuf);
    oled_draw_volume_bar(vol_percent);
    oled_flush();
}
