## smart_amp_proto/main/Kconfig.projbuild
```kconfig
menu "SokolAudio (Smart Amp) Configuration"

config SOKOL_DAC_MCLK_ENABLE
    bool "Route I2S MCLK to PCM5102A (GPIO15)"
    default n
    help
        Most cheap PCM5102A modules have an internal PLL (SCK tied to GND) and
        do not need an external master clock. Enable this only if your module
        explicitly requires MCLK on SCK.

config SOKOL_DAC_MUTE_PIN_ENABLE
    bool "Drive DAC_MUTE (GPIO13 -> PCM5102A XSMT/FLT)"
    default n
    help
        Breakout boards rarely expose PCM5102A's XSMT pin. Enable only if the
        pin is wired out; otherwise mute sequencing relies on the amplifier
        MUTE pin alone.

config SOKOL_STATUS_LEDS_ENABLE
    bool "Enable status LEDs on GPIO38/39"
    default n
    help
        Extra WiFi/BT status LEDs. Disable if those pins are used by something
        else on your dev board.

config SOKOL_UDP_PORT
    int "UDP audio receiver port"
    default 5005
    range 1024 65535

config SOKOL_RINGBUFFER_SIZE_KB
    int "Audio ringbuffer size (KB, in PSRAM)"
    default 2048
    range 256 4096

endmenu
```

## smart_amp_proto/sdkconfig.defaults
```kconfig
# ===== Target =====
CONFIG_IDF_TARGET="esp32s3"
CONFIG_ESP32S3_DEFAULT_CPU_FREQ_240=y

# ===== PSRAM (WROOM-1-N16R8, 8 MB octal) =====
CONFIG_SPIRAM=y
CONFIG_SPIRAM_MODE_OCT=y
CONFIG_SPIRAM_TYPE_AUTO=y
CONFIG_SPIRAM_SPEED_80M=y
CONFIG_SPIRAM_USE_MALLOC=y
CONFIG_SPIRAM_MALLOC_ALWAYSINTERNAL=16384
CONFIG_SPIRAM_TRY_ALLOCATE_WIFI_LWIP=y

# ===== Flash (16 MB) =====
CONFIG_ESPTOOLPY_FLASHSIZE_16MB=y
CONFIG_ESPTOOLPY_FLASHMODE_QIO=y
CONFIG_PARTITION_TABLE_CUSTOM=y
CONFIG_PARTITION_TABLE_CUSTOM_FILENAME="partitions.csv"

# ===== FreeRTOS =====
CONFIG_FREERTOS_HZ=1000
CONFIG_FREERTOS_UNICORE=n

# ===== I2S (ESP-IDF v5 new driver) =====
CONFIG_I2S_ISR_IRAM_SAFE=y

# ===== Wi-Fi =====
CONFIG_ESP_WIFI_DYNAMIC_RX_BUFFER_NUM=32
CONFIG_ESP_WIFI_STATIC_TX_BUFFER=y
CONFIG_ESP_WIFI_AMPDU_TX_ENABLED=y
CONFIG_ESP_WIFI_AMPDU_RX_ENABLED=y
CONFIG_LWIP_UDP_RECVMBOX_SIZE=32
CONFIG_LWIP_TCPIP_RECVMBOX_SIZE=32

# ===== Bluetooth: ESP32-S3 NEMÁ BR/EDR (Classic) — A2DP řeší externí BK3266 modul. =====
# BT controller je vypnutý → úspora ~80 KB internal RAM dostupná pro audio buffer.
# Pokud v budoucnu přidáš BLE companion app, přepni jen CONFIG_BT_BLE_ENABLED=y.
CONFIG_BT_ENABLED=n
CONFIG_BT_CLASSIC_ENABLED=n
CONFIG_BT_A2DP_ENABLE=n
CONFIG_BT_SPP_ENABLED=n
CONFIG_BT_BLE_ENABLED=n

# ===== ESP-ADF kodek flagy (FLAC + Opus + AAC dekód) — používá audio_pipeline =====
# LDAC / aptX zůstávají vypnuté (proprietární licence).
CONFIG_ESP_AUDIO_CODEC_FLAC_ENABLED=y
CONFIG_ESP_AUDIO_CODEC_OPUS_ENABLED=y
CONFIG_ESP_AUDIO_CODEC_AAC_ENABLED=y

# ===== HTTPS OTA + cert bundle (pro ota_updater.c) =====
CONFIG_OTA_ALLOW_HTTP=y
CONFIG_ESP_HTTPS_OTA_DECRYPT_CB=n
CONFIG_MBEDTLS_CERTIFICATE_BUNDLE=y
CONFIG_MBEDTLS_CERTIFICATE_BUNDLE_DEFAULT_FULL=y
CONFIG_MBEDTLS_HARDWARE_AES=y
CONFIG_BOOTLOADER_APP_ROLLBACK_ENABLE=y

# ===== Power management =====
CONFIG_PM_ENABLE=n
CONFIG_ESP_SYSTEM_PANIC_PRINT_REBOOT=y

# ===== Console / CLI =====
CONFIG_ESP_CONSOLE_UART_DEFAULT=y
CONFIG_ESP_CONSOLE_UART_BAUDRATE=115200

# ===== Logy =====
CONFIG_LOG_DEFAULT_LEVEL_INFO=y
CONFIG_LOG_MAXIMUM_LEVEL_DEBUG=y
CONFIG_LOG_TIMESTAMP_SOURCE_RTOS=y

# ===== Task watchdog =====
CONFIG_ESP_TASK_WDT_INIT=y
CONFIG_ESP_TASK_WDT_TIMEOUT_S=10
CONFIG_ESP_TASK_WDT_PANIC=n
```
